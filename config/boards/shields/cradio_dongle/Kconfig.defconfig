## config/boards/shields/cradio_dongle/Kconfig.defconfig
```kconfig
if SHIELD_CRADIO_DONGLE

config ZMK_KEYBOARD_NAME
    default "Cradio Dongle"

config ZMK_SPLIT
    default y

endif
```

## config/boards/shields/cradio_dongle/Kconfig.shield
```kconfig
config SHIELD_CRADIO_DONGLE
    def_bool $(shields_list_contains,cradio_dongle)
    select ZMK_SPLIT
    select ZMK_SPLIT_ROLE_CENTRAL
```
